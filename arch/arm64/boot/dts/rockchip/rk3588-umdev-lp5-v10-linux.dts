// SPDX-License-Identifier: (GPL-2.0+ OR MIT)
/*
 * Copyright (c) 2022 Rockchip Electronics Co., Ltd.
 *
 */

/dts-v1/;

#include "rk3588-umdev-lp5.dtsi"
#include "rk3588-linux.dtsi"

/ {
	model = "UMDEV RK3588 LP5 Linux Board";
	compatible = "rockchip,rk3588-umdev-lp5-v10", "rockchip,rk3588";
};